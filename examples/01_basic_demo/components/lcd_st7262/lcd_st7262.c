/*
 * ST7262E43 RGB LCD 驱动 (基于 ESP-S31-Korvo-1 官方 BSP)
 * 4.3 inch, 800x480, RGB565
 *
 * ST7262E43 直接接收 RGB 并行信号, 无需 SPI 初始化.
 * 关键: pclk_active_neg = true (下降沿锁存数据)
 *
 * RGB 并行接口引脚:
 *   R3-R7: GPIO19,33,34,35,36
 *   G2-G7: GPIO13,14,15,16,17,18
 *   B3-B7: GPIO8,9,10,11,12
 *   PCLK=GPIO40  HSYNC=GPIO44  VSYNC=GPIO45  DE=GPIO43
 *   DISP/背光: NC (硬连接)
 *
 * 触摸 I2C (GT1151): SDA=GPIO0  SCL=GPIO1  (后续添加)
 */

#include <stdio.h>
#include <string.h>
#include "freertos/FreeRTOS.h"
#include "freertos/task.h"
#include "esp_lcd_panel_rgb.h"
#include "esp_lcd_panel_ops.h"
#include "esp_err.h"
#include "esp_log.h"
#include "lcd_st7262.h"

static const char *TAG = "LCD";

/* ==================== RGB 并行引脚 (与官方 BSP 一致) ==================== */
#define LCD_PIN_DATA0   GPIO_NUM_8
#define LCD_PIN_DATA1   GPIO_NUM_9
#define LCD_PIN_DATA2   GPIO_NUM_10
#define LCD_PIN_DATA3   GPIO_NUM_11
#define LCD_PIN_DATA4   GPIO_NUM_12
#define LCD_PIN_DATA5   GPIO_NUM_13
#define LCD_PIN_DATA6   GPIO_NUM_14
#define LCD_PIN_DATA7   GPIO_NUM_15
#define LCD_PIN_DATA8   GPIO_NUM_16
#define LCD_PIN_DATA9   GPIO_NUM_17
#define LCD_PIN_DATA10  GPIO_NUM_18
#define LCD_PIN_DATA11  GPIO_NUM_19
#define LCD_PIN_DATA12  GPIO_NUM_33
#define LCD_PIN_DATA13  GPIO_NUM_34
#define LCD_PIN_DATA14  GPIO_NUM_35
#define LCD_PIN_DATA15  GPIO_NUM_36

#define LCD_PIN_PCLK    GPIO_NUM_40
#define LCD_PIN_VSYNC   GPIO_NUM_45
#define LCD_PIN_HSYNC   GPIO_NUM_44
#define LCD_PIN_DE      GPIO_NUM_43

/* ==================== 屏幕参数 (与官方 BSP 一致) ==================== */
#define LCD_PCLK_HZ         (18 * 1000 * 1000)
#define LCD_HSYNC_PW        1
#define LCD_HSYNC_BP        40
#define LCD_HSYNC_FP        20
#define LCD_VSYNC_PW        1
#define LCD_VSYNC_BP        10
#define LCD_VSYNC_FP        5

static esp_lcd_panel_handle_t panel_handle = NULL;

/* ==================== 8x16 ASCII 字库 ==================== */
const uint8_t font_8x16_data[95][16] = {
    {0x00,0x00,0x00,0x00,0x00,0x00,0x00,0x00,0x00,0x00,0x00,0x00,0x00,0x00,0x00,0x00},
    {0x00,0x00,0x00,0x18,0x18,0x18,0x18,0x18,0x18,0x18,0x00,0x00,0x18,0x18,0x00,0x00},
    {0x00,0x00,0x66,0x66,0x66,0x00,0x00,0x00,0x00,0x00,0x00,0x00,0x00,0x00,0x00,0x00},
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    {0x00,0x00,0x00,0x00,0x00,0x00,0x66,0x3C,0x00,0x00,0x00,0x00,0x00,0x00,0x00,0x00},
};

/* ==================== 绘图函数 ==================== */
void lcd_draw_string(uint16_t *fb, int x, int y, const char *str,
                     uint16_t fg, uint16_t bg)
{
    int sx = x;
    while (*str) {
        if (*str == '\n') { x = sx; y += 16; str++; continue; }
        char c = *str;
        if (c < 32 || c > 126) c = '?';
        const uint8_t *f = font_8x16_data[c - 32];
        for (int r = 0; r < 16; r++) {
            uint8_t d = f[r];
            for (int cl = 0; cl < 8; cl++) {
                int px = x + cl, py = y + r;
                if (px >= 0 && px < LCD_H_RES && py >= 0 && py < LCD_V_RES)
                    fb[py * LCD_H_RES + px] = (d & (0x80 >> cl)) ? fg : bg;
            }
        }
        x += 8; str++;
    }
}

void lcd_clear(uint16_t *fb, uint16_t color) {
    for (int i = 0; i < LCD_H_RES * LCD_V_RES; i++) fb[i] = color;
}

uint16_t rgb888_to_rgb565(uint8_t r, uint8_t g, uint8_t b) {
    return ((r & 0xF8) << 8) | ((g & 0xFC) << 3) | ((b & 0xF8) >> 3);
}

/* ==================== 数据引脚填充 (与官方 BSP 一致) ==================== */
static void fill_data_gpio_nums(gpio_num_t *pins)
{
    pins[0]  = LCD_PIN_DATA0;
    pins[1]  = LCD_PIN_DATA1;
    pins[2]  = LCD_PIN_DATA2;
    pins[3]  = LCD_PIN_DATA3;
    pins[4]  = LCD_PIN_DATA4;
    pins[5]  = LCD_PIN_DATA5;
    pins[6]  = LCD_PIN_DATA6;
    pins[7]  = LCD_PIN_DATA7;
    pins[8]  = LCD_PIN_DATA8;
    pins[9]  = LCD_PIN_DATA9;
    pins[10] = LCD_PIN_DATA10;
    pins[11] = LCD_PIN_DATA11;
    pins[12] = LCD_PIN_DATA12;
    pins[13] = LCD_PIN_DATA13;
    pins[14] = LCD_PIN_DATA14;
    pins[15] = LCD_PIN_DATA15;
    for (int i = 16; i < 24; i++) pins[i] = GPIO_NUM_NC;
}

/* ==================== LCD 初始化 (与官方 BSP 一致) ==================== */
esp_err_t lcd_st7262_init(void)
{
    ESP_LOGI(TAG, "Init ST7262E43 LCD (800x480 RGB565, 18MHz PCLK)");

    esp_lcd_rgb_panel_config_t cfg = {
        .clk_src = LCD_CLK_SRC_DEFAULT,
        .timings = {
            .pclk_hz           = LCD_PCLK_HZ,
            .h_res             = LCD_H_RES,
            .v_res             = LCD_V_RES,
            .hsync_pulse_width = LCD_HSYNC_PW,
            .hsync_back_porch  = LCD_HSYNC_BP,
            .hsync_front_porch = LCD_HSYNC_FP,
            .vsync_pulse_width = LCD_VSYNC_PW,
            .vsync_back_porch  = LCD_VSYNC_BP,
            .vsync_front_porch = LCD_VSYNC_FP,
            .flags = { .pclk_active_neg = true },  /* ★ 关键: 下降沿锁存 */
        },
        .data_width        = 16,
        .in_color_format   = LCD_COLOR_FMT_RGB565,
        .out_color_format  = LCD_COLOR_FMT_RGB565,
        .num_fbs           = 1,
        .dma_burst_size    = 64,                   /* 与官方一致 */
        .hsync_gpio_num    = LCD_PIN_HSYNC,
        .vsync_gpio_num    = LCD_PIN_VSYNC,
        .de_gpio_num       = LCD_PIN_DE,
        .pclk_gpio_num     = LCD_PIN_PCLK,
        .disp_gpio_num     = GPIO_NUM_NC,          /* DISP 硬连接 */
        .flags = { .fb_in_psram = true },
    };
    fill_data_gpio_nums(cfg.data_gpio_nums);

    ESP_ERROR_CHECK(esp_lcd_new_rgb_panel(&cfg, &panel_handle));
    ESP_ERROR_CHECK(esp_lcd_panel_reset(panel_handle));

    /* 填充帧缓冲为黑色 */
    void *fb = NULL;
    esp_lcd_rgb_panel_get_frame_buffer(panel_handle, 1, &fb);
    if (fb) memset(fb, 0, LCD_H_RES * LCD_V_RES * 2);

    ESP_ERROR_CHECK(esp_lcd_panel_init(panel_handle));
    ESP_LOGI(TAG, "LCD initialized successfully");
    return ESP_OK;
}

esp_lcd_panel_handle_t lcd_get_panel(void) { return panel_handle; }

uint16_t* lcd_get_frame_buffer(void)
{
    void *fb = NULL;
    esp_lcd_rgb_panel_get_frame_buffer(panel_handle, 1, &fb);
    return (uint16_t *)fb;
}

void lcd_get_frame_buffers(uint16_t **fb0_out, uint16_t **fb1_out)
{
    void *fb0 = NULL, *fb1 = NULL;
    esp_lcd_rgb_panel_get_frame_buffer(panel_handle, 2, &fb0, &fb1);
    *fb0_out = (uint16_t *)fb0;
    *fb1_out = (uint16_t *)fb1;
}

esp_err_t lcd_refresh(void)
{
    return esp_lcd_panel_draw_bitmap(panel_handle, 0, 0, LCD_H_RES, LCD_V_RES, NULL);
}
